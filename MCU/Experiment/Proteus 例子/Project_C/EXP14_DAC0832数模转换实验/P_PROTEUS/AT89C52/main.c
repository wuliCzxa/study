/***********************************************************  
文件名称： main.c 
作 者：    zw sangel
版 本：    V1.00
说 明：    DAC0832数模转换实验 
修改记录：  
------------------------------------------------------------
*功能描述: 数模转换                                                                
*          产生一锯齿波                                     			       
*          产生一个方波                                                    
*          循环…………   					                               
*-----------------------------------------------------------                 					                                       
*接线说明：P36-WR，P27-CS,P00~P07-DB0~DB7                 					                                       
*                                                                                                                                                            
************************************************************/
#include<reg52.h>
#include<absacc.h> 

#define DAC0832 XBYTE[0x7fff]    /* 定义DAC0832端口地址 */
#define uchar unsigned char
#define uint unsigned int
void delay(uint t) {            /* 延时函数 */
    while(t--);
}



void square(void) {              /* 方波发生函数 */
   DAC0832=0x00;				 //输出低电平
   delay(0x50);
   DAC0832=0x3f;				 //输出高电平
   delay(0x50);
}
/**************主函数***************************************/
void main(void) 
{
   	uchar i;
   	while(1)
	{
   		for (i=0;i<0xff;i++) 
		{
      		DAC0832=i;			//产生一段锯齿波
	  		delay(5000);
		}
   		              
   		//square();             /* 产生一段方波 */ 
   		
	}
}