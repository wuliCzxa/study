/************************************************************************ 
文件名称： main.c 
作 者：    
版 本：    V1.00
说 明：    BCD译码显示实验 
修改记录：  
-------------------------------------------------------------------------   
*功能描述: BCD译码
*
-------------------------------------------------------------------------
*接线说明：P00~P03-A,B,C,D，P20-C0，P21-RBI,P22-LT,QA~QG—SA~SG
*                                                           
*************************************************************************/
#include <reg52.h>
#define uchar unsigned char
#define uint unsigned int
#define BCD  P0
/********端口定义********************************************************/
sbit C0  = P2^0;
sbit RBI = P2^1;
sbit LT  = P2^2;

/**********nms延时子程序*************************************************/
void Delay_Nms(uint n)
{
	uint i,j;
	for(i=0;i<n;i++)
		for(j=0;j<125;j++)
			;
}

/********主函数**********************************************************/
void main(void)
{
	uchar i;
	C0=1;
  RBI=1;
  LT=1;

	while(1)
	{
		for(i=0;i<15;i++)
		{
			BCD=i;           //译码显示
		 	Delay_Nms(500);  //延时
		}
	}

}

