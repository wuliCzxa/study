/************************************************************************ 
文件名称： main.c 
作 者：    
版 本：    V1.00
说 明：    计数器实验 
修改记录：  
-------------------------------------------------------------------------   
* 功能描述: 计数器程序
* 对外部脉冲进行计数，并通过4位数码管显示计数值 
-------------------------------------------------------------------------
* 接线说明：P00~P07——SA~SH，P20~P23——C0~C3，P34——外部脉冲
*                                                           
*************************************************************************/
#include <reg52.h>
#include <intrins.h>
#define uchar unsigned char	  //数据类型宏定义
#define uint unsigned int
#define out  P0				  //IO端口定义
/*******共阳数码管 0 ，  1  ，2  ，3 ， 4  ，5  ，6 ， 7，  8  ，9 ******/
uchar code seg[]={0xc0,0xf9,0xa4,0xb0,0x99,0x92,0x82,0xf8,0x80,0x90,0x01};

uint i = 0;	 //全局变量 
uint cnt=0;
/***********主函数*******************************************************/
void main(void)
{
	int j;

	TMOD=0x15;                          // 定时器0工作于计数方式，工作方式1，16位计数
	                                    // 定时器1工作于定时方式，工作方式1，16位定时
	TH0=0;								// 清零计数器
	TL0=0;
	TH1=0x4C;							// 12M晶振工作下，定时50ms
	TL1=0x00;
	TR0=1;								// 启动定时器0
	TR1=1;								// 启动定时器1
	IE=0x88;							// 打开定时中断1和总中断
	while(1)
	{			 
		P2=0x00;  						// 输出百位
		out = seg[cnt/100];	
		P2 = 0x01;
		for(j=0;j<100;j++);

		P2=0x00;
		out = seg[cnt%100/10];			// 输出十位
		P2 = 0x02;	 
		for(j=0;j<100;j++);	  

		P2=0x00;						
		out = seg[cnt%10];			 	// 输出个位
		P2 = 0x04;
		for(j=0;j<100;j++);
	}		   
}
 
/***********计数器T0中断处理函数******************************************/
void Timer1_ISR() interrupt 3
{
	static char j = 0;
	 i++;
	TH1=0x4C;						   // 重设定时器值，50ms @ 12MHz XTAL
	TL1=0x00;
	if(++j == 20)					   // 50ms * 20 = 1S
	{			  
		j = 0;
		i = (TH0 << 8) | TL0;		   // 1S内的计数值
		cnt=i;
		i=0;
		TH0 = 0;					   // 清零计数
		TL0 = 0;	 
	}
}