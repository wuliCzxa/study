/*****************************************************************  
文件名称： main.c 
作 者：    zw sangel
版 本：    V1.00
说 明：    主程序文件 
修改记录：  
------------------------------------------------------------------
*Descriptoon: 外部中断计数实验                                                                                                                         
*通过一个安键来提供中断信号，但是由于按键有抖动现象，所以每按一次
*有可能产生多次计数脉冲
*当有外部中断时（用按键K1模拟外部中断），计数器加1                                      
------------------------------------------------------------------
*    计数值单位,寄存器与数码管对应关系:                                        
*                                                                              
* --- 单位 ---------- 数码管端口 ---- 缓冲区 ---------                         
*     千位               P10        dis_buf[3]                                 
*     百位               P11        dis_buf[2]                                 
*     十位               P12        dis_buf[1]                                
*     个位               P13        dis_buf[0]                                 
*-----------------------------------------------------------------
*接线说明：P00~P07——SA~SH，P10~P13——C0~C3，P32——K1                                                                             
******************************************************************/
#include <reg52.h>
#include <intrins.h>

#define uchar  unsigned char
#define uint  unsigned int
/**********************共阳数码管编码表***************************/
unsigned char code dis_code[11]={0xc0,0xf9,0xa4,0xb0,	// 0, 1, 2, 3
								 0x99,0x92,0x82,0xf8,0x80,0x90, 0xff};// 4, 5, 6, 7, 8, 9, off 
unsigned char dis_buf[4];		// 显示缓冲区
uint int0_cnt=0; 				//计数初始化
/**********************函数定义***********************************/ 
void update_disbuf();
void delayms(uint j);
/**********************主函数*************************************/ 
void main(void)
{
	IE=0X81;  		//开总中断和外中断0
	IT0=1;			//下降沿触发
	P0=0xff;		//初始化io口
	P1=0;
	dis_buf[0]=dis_code[0];	//缓冲器初始化
	dis_buf[1]=dis_code[0];
	dis_buf[2]=dis_code[0];
	dis_buf[3]=dis_code[0];
	while(1)
	{
		P0=dis_buf[3];
        P1=0x01;			// 显示千位
        delayms(5);
		P0=0xff;
        P0=dis_buf[2];		// 显示百位
        P1=0x02;
        delayms(5);
		P0=0xff;
        P0=dis_buf[1];		// 显示十位
        P1=0x04;
        delayms(5);
		P0=0xff;
        P0=dis_buf[0];		// 显示个位
        P1=0x08;
        delayms(5);
		P0=0xff;
	}
}
/*********************INT0中断处理函数*****************************/
void ex_int0()interrupt 0
{
	EX0=0;				                    //关闭中断
	int0_cnt++;			                    //计数器加1
	if(int0_cnt>9999)						//判断
	int0_cnt=0;	
	dis_buf[3]=dis_code[int0_cnt/1000];		//分离出千位数
	dis_buf[2]=dis_code[int0_cnt%1000/100];	//分离出百位数
	dis_buf[1]=dis_code[int0_cnt%100/10];	//分离出十位数
	dis_buf[0]=dis_code[int0_cnt%10];		//分离出个位数
	EX0=1;									//开中断
}
/*********************延时函数*************************************/
void delayms(uint j)
{
	uchar i;
	for(;j>0;j--)
  	{
		i=250;
   	 	while(--i);
   	 	i=249;
   	 	while(--i);
   	}
}            