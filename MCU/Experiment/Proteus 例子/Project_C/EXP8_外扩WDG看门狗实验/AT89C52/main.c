/*******************************************************************************  
文件名称： main.c 
作 者：    
版 本：    V1.00
说 明：    外扩WDG看门狗实验
-------------------------------------------------------------------------------
*功能描述:                               
*当开关SW1置高时，程序清除硬件看门狗 LED流水灯正常运行                     
*当开关SW1置低时，程序不清除看门狗，导致程序复位，LED流水灯无法正常运行                                           
*注意：因AT89S52单片机为高电平复位，而MAX705复位为低电平，所以需加一个反向器
*------------------------------------------------------------------------------
*接线说明：P10-SW1 ，P11-WDT,/RESET经过反相后接单片机的RST,P00~P07-D1~D8
*******************************************************************************/
#include<reg52.h>
#include <intrins.h>

#define uchar unsigned char	 //数据类型宏定义
#define uint unsigned int
/********引脚定义**************************************************************/
#define LED   P0
sbit SW1=P1^0;
sbit WDT=P1^1;
/********延时函数**************************************************************/
void delayms(uchar ms)	
// 延时子程序
{						
	unsigned char i;
	while(ms--)
	{
		for(i = 0; i < 120; i++);
	}
}
/*********主函数***************************************************************/
void main(void)
{
	LED = 0xfe;	       //初始化LED
	WDT=1;
	_nop_();		   //初始化看门狗
	WDT=0;
	_nop_();
	WDT=1;
	_nop_();
	WDT=0;
	
	while(1)
	{
		if(SW1)		   //SW1=1时，喂狗
		{
			WDT=1;
			_nop_();
			WDT=0;
			_nop_();
			WDT=1;
			_nop_();
			WDT=0;	
		}
		delayms(150);		//延时
		delayms(150);			
		LED = _crol_(LED,1);//循环右移1位，点亮下一个LED
	}
}