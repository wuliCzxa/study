/*************************************************  
*文件名称： main.c 
*作 者：    
*版 本：    V1.00
*说 明：    直流电机测速控制实验
*修改记录：  
--------------------------------------------------
*Descriptoon: 直流电机在1S中内转的圈数，通过数码管
              显示测量值
*接线说明：   P00~P07-SA~SH，P10~P12-C0~C2，P20-SW1
              P22-IN1，P23-IN2,P34-PLU,EN1-+5V               
**************************************************/

#include <reg52.h>
#include <intrins.h>
#define uchar unsigned char
#define uint unsigned int
#define out  P0
uchar code seg[]={0xc0,0xf9,0xa4,0xb0,0x99,0x92,0x82,0xf8,0x80,0x90,0x01};
/**********端口定义*******************************/
//sbit EN1=P2^1;
sbit SW1=P2^0;
sbit IN1=P2^1;
sbit IN2=P2^2;

int i = 0;	  
/***********主函数********************************/
void main(void)
{
	int j;

	TMOD=0x15;                          // 定时器0工作于计数方式，工作方式1，16位计数
	                                    // 定时器1工作于定时方式，工作方式1，16位定时
	TH0=0;								// 清零计数器
	TL0=0;
	TH1=0x4C;							// 11.0592M晶振工作下，定时50ms
	TL1=0x00;
	TR0=1;								// 启动定时器0
	TR1=1;								// 启动定时器1
	IE=0x88;							// 打开定时中断1和总中断

	while(1)
	{	
		if(SW1)							//SW1=1，正转
        {
            IN1=1;
            IN2=0;
        }
        else							//SW1=0，反转
        {
            IN1=0;
            IN2=1;
        }
	//	i=i/4;	
                P1 = 0x00;	
		out = seg[i/100];				//输出百位
		P1 = 0x01;
		for(j=0;j<100;j++);
                
		
		P1 = 0x00;
		out = seg[i%100/10];			// 输出十位
		P1 = 0x02;	 
		for(j=0;j<100;j++);	  
		
                P1 = 0x00;		
		out = seg[i%10];			 	// 输出个位
		P1 = 0x04;
		for(j=0;j<100;j++);
	}		   
}
 
/************计数器1中断处理函数*********************/
void Timer1_ISR() interrupt 3
{
	static char j = 0;
	TH1=0x4C;						   // 重设定时器值，50ms @ 11.0592MHz XTAL
	TL1=0x00;
	if(++j == 20)					   // 50ms * 20 = 1S
	{			  
		j = 0;
		i = (TH0 << 8) | TL0;		   // 1S内的计数值即为电机转动速度,单位为：转/秒
		i=i/4;						   //4个脉冲为一圈，除以4得到转速
		TH0 = 0;					   // 清零计数
		TL0 = 0;	 
	}
}