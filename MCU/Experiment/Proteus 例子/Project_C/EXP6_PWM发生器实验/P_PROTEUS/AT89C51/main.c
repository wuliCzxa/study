/************************************************************************* 
文件名称： main.c 
作 者：    
版 本：    V1.00
说 明：    PWM发生器实验
修改记录：  
--------------------------------------------------------------------------
*Descriptoon:通过对P0^0脚占空比调整输出10个级别的调整波形，可通过示波器观
             察，或者是驱动LED，可以看到其亮暗变化
*接线说明：  P0^0-D1（或示波器）			           
*************************************************************************/
#include<reg52.h>
#include <intrins.h>

#define uchar unsigned char	 //数据类型宏定义
#define uint unsigned int
/**********引脚定义*****************************************************/

uchar PWM_T = 0;     //占空比控制变量  
sbit  PWM_OUT=P0^0;	 //占空比输出脚

void main(void)        
{  
      bit flag = 1; //控制灯渐亮渐熄方式 
      uint n; 
      TMOD=0x02;    //定时器0，工作模式2，8位定时模式  
      TH0=241;      //写入预置初值241到定时器0，使15微秒溢出一次（11.0592MHz）  
      TL0=241;      //写入预置值  
      TR0=1;        //启动定时器  
      ET0=1;        //允许定时器0中断 
      EA=1;         //允许总中断 
      PWM_OUT=1;    //初始化P1 

      while(1)      
      {       
             for(n=0;n<30000;n++);  //延时，将响应定时器中断 
             if(flag==1)        
             PWM_T++; 
             else           
             PWM_T--;                       
             if(PWM_T>=10)         //设置级别为10 
             flag=0; 
             if(PWM_T==0)          //限定最低级别为0 
             flag = 1; 
      }          
}  

/*********************定时器中断0**************************************/
timer0() interrupt 1 using 2    
{  
      static  uchar   t ;   //t用来保存当前时间在一秒中的比例位置  
      t++;    		        //每15微秒增加1 
      if(t==10)   	        //1.5毫秒的时钟周期  
      {  
      		t=0;            //使t=0，开始新的PWM周期
            PWM_OUT=0;      //输出0               
      } 
      if(PWM_T==t)          //按照当前占空比切换输出为高电平  
	  PWM_OUT=1;            //输出1             
} 

