/*******************************************************************************  
文件名称： main.c 
作 者：    zw sangel
版 本：    V1.00
说 明：    主程序文件 
修改记录：  
--------------------------------------------------------------------------------
*Descriptoon: RAM读写实验                                                                                                                           	   
*向内存中写入数据0x58，然后读出，用两位数码管显示读出的值			                                
--------------------------------------------------------------------------------
*    计数值单位,寄存器与数码管对应关系:                                        
*                                                                              
* --- 单位 ---------- 数码管端口 ---- 缓冲区 ---------                         
*     十位               P20        dis_buf[0]                                 
*     个位               P21        dis_buf[1]                                 
*-------------------------------------------------------------------------------
*接线说明：P00~P07——SA~SH，P20 ~P21—— C0~C1                                                                             
*******************************************************************************/
#include <reg52.h>
#include <intrins.h>

#define uchar  unsigned char //数据类型宏定义
#define uint  unsigned int

uchar data dis_digit;		 //申明一个全局变量
/*********************共阳数码管编码表*****************************************/
uchar code dis_code[16]={0xc0,0xf9,0xa4,0xb0,	// 0, 1, 2, 3
				0x99,0x92,0x82,0xf8,0x80,0x90,0x88,0x83,0xc6,0xa1,0x86,0x8e};// 4, 5, 6, 7, 8, 9,a,b,c,d,e,f 
uchar data dis_buf[2];//数据缓冲器
uchar data RW_Add;  //在DATA区定义一个字符变量
void delayms(uchar ms);
/*********************主函数***************************************************/
void main(void)
{
	uchar i;
	P0 = 0xff;		                            //关闭段码
	P2 = 0x00;		                            //关闭位选
		
	dis_buf[0] = 0xbf;				            // 显示"-"
	dis_buf[1] = 0xbf;				            // 显示"-"
				
	dis_digit = 0x01;


	while(1)
	{
	    RW_Add=0x58;				            //写入的字节
		dis_buf[0]=dis_code[(RW_Add&0xf0)>>4];	//写入5
		dis_buf[1]=dis_code[RW_Add&0x0f];		//写入8
												
		dis_digit=0x01;							
		for(i=0;i<2;i++)
		{
			P0=dis_buf[i];						// 显示数据
			P2=dis_digit;
			delayms(5);							//延时
			P0=0xff;
			dis_digit<<=1;						//左移1位
		}	
	}
}
/***************延时函数*********************************************************/
void delayms(unsigned char ms)	
// 延时子程序
{						
	unsigned char i;
	while(ms--)
	{
		for(i = 0; i < 120; i++);
	}
}

