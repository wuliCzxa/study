/************************************************************************ 
文件名称： main.c 
作 者：    
版 本：    V1.00
说 明：    IO开关量输入实验 
修改记录：  
-------------------------------------------------------------------------   
* 功能描述: 按键扫描程序
* 上电时, 点亮P00口LED ，按下K1时, LED向右移一位，按下K2时, LED向左移一位 
-------------------------------------------------------------------------
* 接线说明：P10-K1，P11-K2，P00~P07——D1~D8
*                                                           
*************************************************************************/
#include <reg52.h>
#include <intrins.h>

#define uchar unsigned char	 //数据类型宏定义
#define uint unsigned int

/**********单片机IO口引脚定义********************************************/
#define LED   P0
sbit	K1 = P1^0;
sbit	K2 = P1^1;
/**********函数定义******************************************************/
uchar scan_key();
void proc_key(uchar key_v);
void delayms(uchar ms);
/**********主函数********************************************************/
void main(void)
{																						  
	uchar key_s,key_v;
	key_v = 0x03;		     //初始化IO口
	LED = 0xfe;
	while(1)
	{
	   delayms(10);
		key_s = scan_key();
		if(key_s != key_v)	 //判断按键是否按下
		{
			delayms(10);	 //延时消抖
			key_s = scan_key();
			if(key_s != key_v)
			{	
				key_v = key_s;
				proc_key(key_v);					
			}
		}
	}	
}
/**********键盘扫描函数**************************************************/
uchar scan_key()
{
	uchar key_s;
	key_s = 0x00;
	key_s |= K2;
	key_s <<= 1;
	key_s |= K1;
	return key_s;			  //返回按键号
}
/**********键盘处理函数**************************************************/
void proc_key(uchar key_v)
{
	if((key_v & 0x01) == 0)
	{
		LED = _cror_(LED,1);  //循环右移一位
	}
	else if((key_v & 0x02) == 0)
	{
		LED = _crol_(LED, 1); //循环左移一位
	}
}
/***********延时函数*****************************************************/
void delayms(uchar ms)	
// 延时子程序
{						
	uchar i;
	while(ms--)
	{
		for(i = 0; i < 120; i++);
	}
}
