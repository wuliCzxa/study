/*******************************************************************************     
文件名称： main.c 
作 者：    
版 本：    V1.00
说 明：    74LS164串入并出移位实验 
修改记录：  
-------------------------------------------------------------------------------- 
功能描述:                                                              
*          控制74LS164                                                 
*          循环送出从0到0XFF 256个8位数据                                         
*          实现串行数据输入 并行数据输出 
--------------------------------------------------------------------------------
*接线说明：P10-/CLR，P11-CP,P12-SI,QA~QH——D1~D8 ，LED 循环熄灭                                   
*******************************************************************************/
#include <reg52.h>

#define uchar unsigned char
#define uint unsigned int

void delayms(uint);
/**********端口定义***********************************************************/
sbit CLR = P1^0;
sbit CP  = P1^1;
sbit SI  = P1^2;


/**********nms延时子程序******************************************************/
void Delay_Nms(uint n)
{
	uint i,j;
	for(i=0;i<n;i++)
		for(j=0;j<125;j++)
			;
}

/**********发送一字节数据*****************************************************/
void SendOneByte(uchar Bdat)
{  
   uchar i; 
    
    for(i=0;i<8;i++) 
    { 
        SI=(bit)(Bdat & 0x80);     	//判断输出数据 
        CP=0;        			    //初始化移位时钟 
        Bdat<<=1; 				    //更新数据 
        CP=1; 
    }    
}
/**********主函数*************************************************************/
void main(void) 
{ 
    uchar i; 
	CLR = 0;		 //清除164输出
	CLR = 1; 		 //允许164输出
     while(1) 
    {   
		 for(i=0;i<0xff;i++) 
        { 		
            	SendOneByte(i); //译码显示  
				Delay_Nms(500);	//延时
	    }	
    }                
}