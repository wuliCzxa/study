/*****************************************************
程序功能：MCU不停向PC机发送数据,在屏幕上显示公司网站
------------------------------------------------------
通信格式：N.8.1, 9600
------------------------------------------------------
测试说明：打开串口调试助手，正确设置通信格式，观察屏幕
接线说明：P30-TXD，P31-RXD，TXD_RS232-Pin2，RXD_RS232-Pin3
******************************************************/
#include <reg52.h>
#define uchar unsigned char
#define uint unsigned int
uchar a[]="www.windway.cn";
uchar b[]="Welcome to you!";

void UART_Init(void);
void UART_SendData(uchar dat);
void UART_SendString(uchar *p);
void Delayms(uint j);
/********************************************************* 
**函数名称：main()
**函数功能：主函数 
*********************************************************/
void main(void)
{
  	UART_Init();
	while(1)
	{
		UART_SendString(a);	   //发送字符串
		UART_SendData('\n');   //换行
		Delayms(100);		   //延时
	
    }

}


/********************************************************* 
**函数名称：UART_Init()
**函数功能：串口初始化 
*********************************************************/
void UART_Init(void)
{
	SCON=0x50;
    TMOD=0x20;
	PCON=0x00;
    TH1 =0xfd;
	TL1 =0xfd;  //预置初值，设波特率为9600
	TR1 =1;	
   	ES  =1;
	EA  =1;		//开中断

}

/********************************************************* 
**函数名称：UART_SendData()
**函数功能：串口发送一个字节的数据 
*********************************************************/
void UART_SendData(uchar dat)
{
	SBUF=dat;      //发送数据
	while(TI==0);  //判断是否发送完
	TI=1;	
}

/********************************************************* 
**函数名称：
**函数功能：
*********************************************************/
void UART_SendString(uchar *p)
{
  while(*p!='\0')
  {
   UART_SendData(*p++);
  }

}


 /********************************************************* 
**函数名称：Delay()
**函数功能：延时函数 
*********************************************************/
void Delayms(uint j)
{
uchar i;
for(;j>0;j--)
  	{i=250;
   	 while(--i);
   	 i=249;
   	 while(--i);
   	}
}


/********************************************************* 
**函数名称：INT_UART_Rev()
**函数功能：串口接收中断函数 
*********************************************************/
void INT_UART_Rev() interrupt 4
{
	uchar *temp;
	if(RI)
	 {
	   RI=0;
	   *temp++=SBUF;
	  // UART_SendString(temp);
	  // UART_SendString("ok");
	 }

}
