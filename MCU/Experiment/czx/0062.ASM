ADC_PORT	EQU	P0
DAC_PORT	EQU	P1
SW_RELAY	EQU	P3
SEG_PORT	EQU	P2
BIT_PORT	EQU	P3

	ORG	0
	LJMP	MAIN
	ORG	50H

	MAIN:
		MOV	SP,	#60H
		MOV	30H,	#80H

	MAIN_LOOP:
		MOV	C,	SW_RELAY.0
		JC	SWITCH_1

		CLR	SW_RELAY.1
		LCALL	ADC_CONVERT
		LCALL	DISPLAY
		SJMP	MAIN_LOOP

	SWITCH_1:
		SETB	SW_RELAY.1
		MOV	DAC_PORT,	30H
		LCALL	ADC_CONVERT
		LCALL	DISPLAY
		SJMP	MAIN_LOOP

	ADC_CONVERT:
		MOV	ADC_PORT,	#0FFH
		CLR	P3.3
		SETB	P3.3

	WAIT_EOC:
		JB	P3.4,	WAIT_EOC
		MOV	A,	ADC_PORT
		RET

	DISPLAY:
		MOV	B,	#100
		DIV	AB
		MOV	40H,	A
		MOV	A,	B
		MOV	B,	#10
		DIV	AB
		MOV	41H,	A
		MOV	42H,	B

		MOV	DPTR,	#SEG_TABLE

		MOV	A,	40H
		MOVC	A,	@A+DPTR
		MOV	SEG_PORT,	A
		CLR	BIT_PORT.2
		LCALL	DELAY
		SETB	BIT_PORT.2

		MOV	A,	41H
		MOVC	A,	@A+DPTR
		MOV	SEG_PORT,	A
		CLR	BIT_PORT.1
		LCALL	DELAY
		SETB	BIT_PORT.1

		MOV	A,	42H
		MOVC	A,	@A+DPTR
		MOV	SEG_PORT,	A
		CLR	BIT_PORT.0
		LCALL	DELAY
		SETB	BIT_PORT.0

	SEG_TABLE:
		DB	3FH,	06H,	5BH,	4FH,	66H,	6DH,	7DH,	07H,	7FH,	6FH	;	0-9

	DELAY:
		MOV	R6,	#20

	DELAY_LOOP:
		MOV	R7,	#250
		DJNZ	R7,	$
		DJNZ	R6,	DELAY_LOOP
		RET

	END