#include<reg52.h>  // 包含51单片机寄存器定义

// 74HC595 控制端口
sbit shcp = P1^2;  // 移位时钟（Shift Clock）
sbit stcp = P1^1;  // 锁存时钟（Storage Clock / Latch）
sbit ds   = P1^0;  // 串行数据输入（Data Serial）

// 按键输入端口
sbit s1 = P3^1;  // 启停按键
sbit s2 = P3^2;  // 方向切换按键
sbit s3 = P3^3;  // 速度减按键
sbit s4 = P3^4;  // 速度加按键

// 全局变量
unsigned char fx;     // 滚动方向（0：左，1：右，2：未使用）
unsigned char alt;    // 定时器计数变量，用于控制滚动速度
unsigned int net;     // 当前显示的起始字模索引
unsigned char speed=5; // 滚动速度（1~12）
unsigned char zi=15;    // 字符数量
unsigned int zong;    // 字符总字节数

// tab、tab1 为点阵字模数组，每个字符16字节（16x16点阵）
// tab 为正序，tab1 为逆序或镜像显示，用于方向切换

unsigned char code tab[]={ /* 点阵数据省略 */
	
	0x00,0x00,0x00,0x00,0x00,0x00,0x00,0x00,0x00,0x00,0x00,0x00,0x00,0x00,0x00,0x00,
	0x00,0x00,0x00,0x00,0x00,0x00,0x00,0x00,0x00,0x00,0x00,0x00,0x00,0x00,0x00,0x00,
	
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	0x00,0x00,0x00,0x00,0x00,0x00,0x00,0x00,0x00,0x00,0x00,0x00,0x00,0x00,0x00,0x00,
};
unsigned char code tab1[]={ 
	
	0x00,0x00,0x00,0x00,0x00,0x00,0x00,0x00,0x00,0x00,0x00,0x00,0x00,0x00,0x00,0x00,
	0x00,0x00,0x00,0x00,0x00,0x00,0x00,0x00,0x00,0x00,0x00,0x00,0x00,0x00,0x00,0x00,
	
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	0x00,0x00,0x00,0x00,0x00,0x00,0x00,0x00,0x00,0x00,0x00,0x00,0x00,0x00,0x00,0x00,
};

// 延时函数
void delay(unsigned int z)
{
   unsigned char x;
   for(; z>0; z--)       // 外层循环次数
      for(x=110; x>0; x--); // 内层空循环，粗略延时
}

// 向74HC595写入两字节数据（16列）
void writedata(unsigned char dat1, unsigned char dat2)	 
{
	unsigned char i;
	// 写入第1字节
	for(i=0;i<8;i++)
	{
		dat1 = dat1 << 1;  // 左移1位，最高位送到CY标志位
		ds = CY;           // 串行数据输入
		shcp = 1;          // 移位时钟上升沿，74HC595移入数据
		shcp = 0;
	} 
	// 写入第2字节
	for(i=0;i<8;i++)
	{
		dat2 = dat2 << 1;
		ds = CY;
		shcp = 1;
		shcp = 0;
	} 
	// 锁存数据，使输出口显示
	stcp = 0;      
	stcp = 1;
	stcp = 0; 
}

// 主程序
void main()	
{
	char i, aa;
	TMOD = 0x01;  // 定时器0 工作模式1（16位）
	TH0 = (65536-10000)/256;  // 定时器初值高字节
	TL0 = (65536-10000)%256;  // 定时器初值低字节
	ET0 = 1;      // 允许定时器0中断
	EA = 1;       // 开全局中断
	TR0 = 1;      // 启动定时器0
	zong = (zi+1)*32; // 计算总字节数（每字符16字节，双字节表示？）

	while(1)	 
	{
		// 按键检测，启停控制
		if(s1 == 0)
		{
			delay(30);  // 按键消抖
			if(s1 == 0)
			{
				TR0 = ~TR0; // 启停切换
				while(s1 == 0); // 按键松开前等待
			}
		}

		// 方向切换
		if(s2 == 0)
		{
			delay(30); 
			if(s2 == 0)
			{
				fx++;
				if(fx >= 2) fx = 0; // fx只循环0、1
				aa = 0; // 每行显示数据重新计数
				if(fx == 0) net = 0;    // 左滚起点
				if(fx == 1) net = zong; // 右滚起点
				while(s2 == 0);
			}
		}

		// 速度减按键
		if(s3 == 0)
		{
			delay(3);
			if(s3 == 0)
			{
				speed--;        // 减速
				if(speed <= 1) speed = 1; // 最小速度限制
			}
			while(!s3);
		}

		// 速度加按键
		if(s4 == 0)
		{
			delay(3);
			if(s4 == 0)
			{
				speed++;        // 加速
				if(speed >= 12) speed = 12; // 最大速度限制
			}
			while(!s4);
		}

		// 逐行刷新点阵显示
		for(i=0;i<16;i++)
		{	  
			P2 = i;  // 选择行（列译码？）
			// 根据滚动方向选择数据表
			if(fx == 0) writedata(tab[net+aa], tab[net+aa+1]);  // 左滚
			if(fx == 1) writedata(tab1[net+aa], tab1[net+aa+1]); // 右滚
			if(fx == 2) writedata(tab[net+aa], tab[net+aa+1]);  // 未使用
			delay(3);  // 每行显示延时
			writedata(0,0); // 清空数据，防止残影
			aa += 2;         // 每次移动两字节
			if(aa > 30) aa = 0; // 每行最多32字节，回到起点
		}
	}
}

// 定时器0中断服务程序，每10ms触发一次
void timer0() interrupt 1
{
	TH0 = (65536-10000)/256;  // 重新装入初值
	TL0 = (65536-10000)%256;
	alt++;  // 定时计数

	// 根据滚动方向调整起点net
	if(fx == 0 || fx == 1)
	{
		if(alt >= speed)  // 根据speed控制滚动速度
		{
			alt = 0;
			if(fx == 0)  // 左滚
			{
				net += 2;	
				if(net > zong) net = 0; // 循环回起点
			}
			if(fx == 1)  // 右滚
			{
				net -= 2;
				if(net < 2) net = zong; // 循环回末尾
			}
		}
	}
}
