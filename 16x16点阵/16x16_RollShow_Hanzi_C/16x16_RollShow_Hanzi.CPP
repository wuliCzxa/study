#include <REG51.H>
#include <intrins.h>

// ====================== 硬件接口定义 ======================
sbit key_l = P2^4;   // 左滚动按键
sbit key_r = P2^6;   // 右滚动按键
sbit key_u = P2^3;   // 上滚动按键
sbit key_d = P2^7;   // 下滚动按键
sbit key_m = P2^5;   // 全屏显示按键
sbit key_change = P3^7; // 切换字模按键

sbit DS = P2^0;     // 串行输入
sbit SH = P2^1;   // 移位时钟
sbit ST = P2^2;    // 存储时钟

// ====================== 系统参数定义 ======================
#define FONTS 3   // 总共有3组字模（可以自行扩展）
#define SIZE 16   // 16x16 点阵

typedef enum {
    SCROLL_LEFT,
    SCROLL_RIGHT,
    SCROLL_UP,
    SCROLL_DOWN,
    SCROLL_FULL
} ScrollMode;

unsigned char current_font_index = 0;   // 当前字模组编号
unsigned char total_fonts = FONTS;      // 字模总数
ScrollMode current_mode = SCROLL_LEFT;  // 默认向左滚动

// ====================== 字模数据定义 ======================
// 每组16行 × 2字节 = 16x16 点阵
code unsigned char fonts[FONTS][128] = {
	{
		0x00,0x0E,0x10,0x10,0x10,0x10,0x0F,0x00,
		0x00,0x0C,0x14,0x24,0x44,0x84,0x0C,0x00,/*"2",0*/
		0x00,0x0E,0x10,0x10,0x10,0x10,0x0F,0x00,
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		0x00,0x00,0x00,0x00,0x00,0x00,0x00,0x00,0x00,0x00,0x00,0x00,0x00,0x00,0x00,0x00
	},
	{
		0x00,0x7F,0x44,0x5A,0x61,0x10,0x11,0x16,
		0x18,0xF0,0x17,0x10,0x10,0x10,0x10,0x00,
		0x00,0xFF,0x20,0x10,0xE0,0x04,0x88,0xB0,
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		0x00,0x00,0x00,0x00,0x00,0x00,0x00,0x00,0x00,0x00,0x00,0x00,0x00,0x00,0x00,0x00
	},
	{
		0x08,0x06,0x40,0x31,0x04,0x18,0x10,0x10,
		0x11,0xFE,0x11,0x10,0x14,0x18,0x10,0x00,
		0x20,0x20,0x7E,0x80,0x01,0x02,0x0C,0x30,
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		0x00,0x00,0x00,0x00,0x00,0x00,0x00,0x00,0x00,0x00,0x00,0x00,0x00,0x00,0x00,0x00
	}

};

// ====================== 基础驱动函数 ======================
void delay_ms(unsigned int t) {
    unsigned int i, j;
    for(i=0; i<t; i++)
        for(j=0; j<120; j++);
}

// 74HC595 串行输出
void hc595_send(unsigned char dat) {
    unsigned char i;
    for(i=0; i<8; i++) {
        SER = (dat & 0x80);
        dat <<= 1;
        SRCLK = 0; SRCLK = 1;
    }
}

// 74HC595 输出锁存
void hc595_latch(void) {
    RCLK = 0; RCLK = 1;
}

// 软件清屏函数：逐行输出0x00
void ClearScreen(void) {
    unsigned char i;
    for(i = 0; i < 16; i++) {
        // 先选择第 i 行（通过 74HC138 控制）
        SelectRow(i);
        // 再发送两字节 0x00（16列清零）
        SendData(0x00);
        SendData(0x00);
        // 锁存数据（通过 74HC595 的 RCLK）
        LatchData();
    }
}

// ====================== 按键扫描函数 ======================
unsigned char scan_key() {
    if(key_l == 0) { delay_ms(20); if(key_l==0) return 'L'; }
    if(key_r == 0) { delay_ms(20); if(key_r==0) return 'R'; }
    if(key_u == 0) { delay_ms(20); if(key_u==0) return 'U'; }
    if(key_d == 0) { delay_ms(20); if(key_d==0) return 'D'; }
    if(key_m == 0) { delay_ms(20); if(key_m==0) return 'M'; }
    if(key_change == 0) { delay_ms(20); if(key_change==0) return 'C'; }
    return 0;
}

// ====================== 按键处理函数 ======================
void key_handler(unsigned char key) {
    switch(key) {
        case 'L':
            current_mode = SCROLL_LEFT;
            current_font_index = 0;   // 初始化显示第一组字模
            break;
        case 'R':
            current_mode = SCROLL_RIGHT;
            break;
        case 'U':
            current_mode = SCROLL_UP;
            break;
        case 'D':
            current_mode = SCROLL_DOWN;
            break;
        case 'M':
            current_mode = SCROLL_FULL;
            break;
        case 'C':   // 切换字模
            current_font_index++;
            if(current_font_index >= total_fonts) {
                current_font_index = 0;
            }
            break;
    }
}

// ====================== 显示函数 ======================
// 全屏覆盖显示
void display_full(unsigned char font[16][2]) {
    unsigned char row;
    for(row=0; row<16; row++) {
        hc595_send(font[row][0]);
        hc595_send(font[row][1]);
        hc595_latch();
        delay_ms(1);
    }
}

// 左滚动
void display_scroll_left(unsigned char font[16][2]) {
    unsigned char row, shift;
    unsigned int col;
    for(shift=0; shift<16; shift++) {   // 每次左移1列，共16列
        for(row=0; row<16; row++) {
            unsigned int line = (font[row][0] << 8) | font[row][1];
            line <<= shift;
            hc595_send(line >> 8);
            hc595_send(line & 0xFF);
            hc595_latch();
        }
        delay_ms(50);
    }
}

// 右滚动
void display_scroll_right(unsigned char font[16][2]) {
    unsigned char row, shift;
    for(shift=0; shift<16; shift++) {
        for(row=0; row<16; row++) {
            unsigned int line = (font[row][0] << 8) | font[row][1];
            line >>= shift;
            hc595_send(line >> 8);
            hc595_send(line & 0xFF);
            hc595_latch();
        }
        delay_ms(50);
    }
}

// 上滚动
void display_scroll_up(unsigned char font[16][2]) {
    unsigned char row, shift;
    for(shift=0; shift<16; shift++) {
        for(row=0; row<16; row++) {
            unsigned char r = (row+shift) % 16;
            hc595_send(font[r][0]);
            hc595_send(font[r][1]);
            hc595_latch();
        }
        delay_ms(80);
    }
}

// 下滚动
void display_scroll_down(unsigned char font[16][2]) {
    unsigned char row, shift;
    for(shift=0; shift<16; shift++) {
        for(row=0; row<16; row++) {
            unsigned char r = (row+16-shift) % 16;
            hc595_send(font[r][0]);
            hc595_send(font[r][1]);
            hc595_latch();
        }
        delay_ms(80);
    }
}

// ====================== 主程序 ======================
void main() {
    unsigned char key;
    while(1) {
        key = scan_key();
        if(key != 0) key_handler(key);

        switch(current_mode) {
            case SCROLL_LEFT:
                display_scroll_left(fonts[current_font_index]);
                break;
            case SCROLL_RIGHT:
                display_scroll_right(fonts[current_font_index]);
                break;
            case SCROLL_UP:
                display_scroll_up(fonts[current_font_index]);
                break;
            case SCROLL_DOWN:
                display_scroll_down(fonts[current_font_index]);
                break;
            case SCROLL_FULL:
                display_full(fonts[current_font_index]);
                break;
        }
    }
}
