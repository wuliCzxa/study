#include<reg52.h>

// 74HC595 控制端口
sbit shcp = P1^2;
sbit stcp = P1^1;
sbit ds   = P1^0;

// 按键输入端口
sbit s1 = P3^1;  // 启停
sbit s2 = P3^2;  // 方向切换
sbit s3 = P3^3;  // 速度减
sbit s4 = P3^4;  // 速度加

// 全局变量
unsigned char fx;
unsigned char alt;
unsigned int  net;
unsigned char speed = 5;  // 滚动速度（1~12）
unsigned char zi    = 7;  // 字符数量：单片机课程设计，共7个字
unsigned int  zong;

// -------------------------------------------------------
// tab[]：正向（左滚）字模
// 顺序：空白 → 单片机课程设计 → 空白
// -------------------------------------------------------
unsigned char code tab[] = {

    // 空白帧
    0x00,0x00,0x00,0x00,0x00,0x00,0x00,0x00,
    0x00,0x00,0x00,0x00,0x00,0x00,0x00,0x00,
    0x00,0x00,0x00,0x00,0x00,0x00,0x00,0x00,
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    0x02,0x00,0xFF,0xFF,0x02,0x00,0x02,0x00,0x02,0x00,0x02,0x00,0x02,0x00,0x00,0x00, /*"计"*/

    // 空白帧
    0x00,0x00,0x00,0x00,0x00,0x00,0x00,0x00,
    0x00,0x00,0x00,0x00,0x00,0x00,0x00,0x00,
    0x00,0x00,0x00,0x00,0x00,0x00,0x00,0x00,
    0x00,0x00,0x00,0x00,0x00,0x00,0x00,0x00,
};

// -------------------------------------------------------
// tab1[]：反向（右滚）字模
// 顺序：空白 → 计设程课机片单 → 空白
// -------------------------------------------------------
unsigned char code tab1[] = {

    // 空白帧
    0x00,0x00,0x00,0x00,0x00,0x00,0x00,0x00,
    0x00,0x00,0x00,0x00,0x00,0x00,0x00,0x00,
    0x00,0x00,0x00,0x00,0x00,0x00,0x00,0x00,
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    0x12,0x48,0x32,0x48,0x52,0x48,0x92,0x48,0x1F,0xC8,0x00,0x08,0x00,0x08,0x00,0x00, /*"单"*/

    // 空白帧
    0x00,0x00,0x00,0x00,0x00,0x00,0x00,0x00,
    0x00,0x00,0x00,0x00,0x00,0x00,0x00,0x00,
    0x00,0x00,0x00,0x00,0x00,0x00,0x00,0x00,
    0x00,0x00,0x00,0x00,0x00,0x00,0x00,0x00,
};

void delay(unsigned int z)
{
    unsigned char x;
    for(; z>0; z--)
        for(x=110; x>0; x--);
}

void writedata(unsigned char dat1, unsigned char dat2)
{
    unsigned char i;
    for(i=0; i<8; i++) { dat1 = dat1 << 1; ds = CY; shcp = 1; shcp = 0; }
    for(i=0; i<8; i++) { dat2 = dat2 << 1; ds = CY; shcp = 1; shcp = 0; }
    stcp = 0; stcp = 1; stcp = 0;
}

void main()
{
    char i, aa;
    TMOD = 0x01;
    TH0  = (65536-10000) / 256;
    TL0  = (65536-10000) % 256;
    ET0  = 1;
    EA   = 1;
    TR0  = 1;
    zong = (zi + 1) * 32;  // = 8 * 32 = 256，覆盖 9 个字模块

    while(1)
    {
        // 启停
        if(s1 == 0) { delay(30); if(s1 == 0) { TR0 = ~TR0; while(s1 == 0); } }

        // 方向切换
        if(s2 == 0)
        {
            delay(30);
            if(s2 == 0)
            {
                fx++;
                if(fx >= 2) fx = 0;
                aa = 0;
                if(fx == 0) net = 0;
                if(fx == 1) net = zong;
                while(s2 == 0);
            }
        }

        // 速度减
        if(s3 == 0) { delay(3); if(s3 == 0) { speed--; if(speed <= 1) speed = 1; } while(!s3); }

        // 速度加
        if(s4 == 0) { delay(3); if(s4 == 0) { speed++; if(speed >= 12) speed = 12; } while(!s4); }

        // 逐行扫描显示
        for(i=0; i<16; i++)
        {
            P2 = i;
            if(fx == 0) writedata(tab[net+aa],  tab[net+aa+1]);   // 左滚：单→计
            if(fx == 1) writedata(tab1[net+aa], tab1[net+aa+1]);  // 右滚：计→单
            delay(3);
            writedata(0, 0);  // 清除残影
            aa += 2;
            if(aa > 30) aa = 0;
        }
    }
}

void timer0() interrupt 1
{
    TH0 = (65536-10000) / 256;
    TL0 = (65536-10000) % 256;
    alt++;

    if(alt >= speed)
    {
        alt = 0;
        if(fx == 0) { net += 2; if(net > zong) net = 0; }   // 左滚
        if(fx == 1) { net -= 2; if(net < 2)    net = zong; } // 右滚
    }
}